## boards/ggf/nrfpcb/Kconfig.nrfpcb
```kconfig
config BOARD_NRFPCB
	select SOC_NRF54L15_CPUAPP if BOARD_NRFPCB_NRF54L15_CPUAPP
	select SOC_NRF54L15_CPUFLPR if \
		BOARD_NRFPCB_NRF54L15_CPUFLPR || \
		BOARD_NRFPCB_NRF54L15_CPUFLPR_XIP
```

## boards/ggf/nrfpcb/board.yml
```yaml
board:
  name: nrfpcb
  full_name: nrfpcb
  vendor: ggf
  socs:
  - name: nrf54l15

runners:
  run_once:
    '--recover':
      - runners:
          - nrfjprog
          - nrfutil
        run: first
        groups:
          - boards:
              - nrfpcb/nrf54l15/cpuapp
    '--erase':
      - runners:
          - nrfjprog
          - jlink
          - nrfutil
        run: first
        groups:
          - boards:
              - nrfpcb/nrf54l15/cpuapp
    '--reset':
      - runners:
          - nrfjprog
          - jlink
          - nrfutil
        run: last
        groups:
          - boards:
              - nrfpcb/nrf54l15/cpuapp
```

## boards/ggf/nrfpcb/nrfpcb_nrf54l15_cpuapp_defconfig
```kconfig
CONFIG_ARM_MPU=y

# MPU-based null-pointer dereferencing detection cannot
# be applied as the (0x0 - 0x400) is unmapped for this target.
CONFIG_NULL_POINTER_EXCEPTION_DETECTION_NONE=y

# Enable Cache
CONFIG_CACHE_MANAGEMENT=y
CONFIG_EXTERNAL_CACHE=y

# Start SYSCOUNTER on driver init
CONFIG_NRF_GRTC_START_SYSCOUNTER=y

CONFIG_ARM_MPU=y
CONFIG_HW_STACK_PROTECTION=y

CONFIG_CLOCK_CONTROL_NRF=y
CONFIG_CLOCK_CONTROL_NRF_K32SRC_RC=y
CONFIG_CLOCK_CONTROL_NRF_K32SRC_XTAL=n
CONFIG_CLOCK_CONTROL_NRF_K32SRC_SYNTH=n
CONFIG_CLOCK_CONTROL_NRF_K32SRC_500PPM=y
CONFIG_CLOCK_CONTROL_NRF_K32SRC_RC_CALIBRATION=y
CONFIG_CLOCK_CONTROL_NRF_CALIBRATION_PERIOD=8000
```

## lib/attest/Kconfig
```kconfig
menu "Attestation"

	config SPV_ATTESTATION_KEYID
		hex "Identity key ID [0x00 to 0xFF]"
		default 0x01
		help
			Selects the internal KMU slot ID in which the identity key will
			be stored.

	config SPV_ATTESTATION_CHALLENGE_LENGTH
		int "Challenge length"
		default 32
		help
			Specifies the Attestation protocol's challenge length.

	config SPV_ATTESTATION_SIGNATURE_SIZE
		int
		default 64

endmenu
```

## lib/mpsl/Kconfig
```kconfig
menu "Init"

	config SPV_INIT_MAX_TRACKED_DEPENDENCIES
		int "Maximum tracked dependencies"
		default 20
		help
			Specifies the maximum amount of unique dependencies the init
			system can track.

	config SPV_INIT_PRINT_DETAILED_ERROR
		bool "Print detailed errors"
		default y
		help
			Show detailed error messages when:
				- Unmeetable dependencies encountered.
endmenu
```
